## zephyr/Kconfig
```kconfig
menuconfig ST25R
	bool "ST25R"
	help
		ST25R NFC reader driver

menuconfig ST25R3916
	bool "ST25R3916"
	depends on ST25R
	help
		ST25R3916 IC driver

menuconfig ST25R3916B
	bool "ST25R3916B"
	depends on ST25R
	help
		ST25R3916B IC driver

if ST25R

config RFAL_USE_I2C
    bool "Enable RFAL support for I2C. If disabled, SPI will be assumed."
    default n

config RFAL_FEATURE_LISTEN_MODE
	bool "Enable RFAL support for Listen Mode"
	default n

config RFAL_FEATURE_WAKEUP_MODE
    bool "Enable RFAL support for the Wake-Up mode"
    default n

config RFAL_FEATURE_LOWPOWER_MODE
    bool "Enable RFAL support for the Low Power mode"
    default n

config RFAL_FEATURE_NFCA
    bool "Enable RFAL support for NFC-A (ISO14443A)"
    default n

config RFAL_FEATURE_NFCB
    bool "Enable RFAL support for NFC-B (ISO14443B)"
    default n

config RFAL_FEATURE_NFCF
    bool "Enable/Disable RFAL support for NFC-F (FeliCa)"
    default n

config RFAL_FEATURE_NFCV
    bool "Enable/Disable RFAL support for NFC-V (ISO15693)"
    default n

config RFAL_FEATURE_T1T
    bool "Enable/Disable RFAL support for T1T (Topaz)"
    default n

config RFAL_FEATURE_T2T
    bool "Enable/Disable RFAL support for T2T"
    default n

config RFAL_FEATURE_T4T
    bool "Enable/Disable RFAL support for T4T"
    default n

config RFAL_FEATURE_ST25TB
    bool "Enable/Disable RFAL support for ST25TB"
    default n

config RFAL_FEATURE_ST25xV
    bool "Enable/Disable RFAL support for  ST25TV/ST25DV"
    default n

config RFAL_FEATURE_DYNAMIC_ANALOG_CONFIG
    bool "Enable/Disable Analog Configs to be dynamically updated (RAM)"
    default n

config RFAL_FEATURE_DPO
    bool "Enable/Disable RFAL Dynamic Power Output support"
    default n

config RFAL_FEATURE_ISO_DEP
    bool "Enable/Disable RFAL support for ISO-DEP (ISO14443-4)"
    default n

config RFAL_FEATURE_ISO_DEP_POLL
    bool "Enable/Disable RFAL support for Poller mode (PCD) ISO-DEP (ISO14443-4)"
    default n

config RFAL_FEATURE_ISO_DEP_LISTEN
    bool "Enable/Disable RFAL support for Listen mode (PICC) ISO-DEP (ISO14443-4)"
    default n

config RFAL_FEATURE_NFC_DEP
    bool "Enable/Disable RFAL support for NFC-DEP (NFCIP1/P2P)"
    default n

config RFAL_FEATURE_ISO_DEP_IBLOCK_MAX_LEN
    int "ISO-DEP I-Block max length. Please use values as defined by rfalIsoDepFSx"
    default 256

config RFAL_FEATURE_NFC_DEP_BLOCK_MAX_LEN
    int "NFC-DEP Block/Payload length. Allowed values: 64, 128, 192, 254"
    default 254

config RFAL_FEATURE_NFC_RF_BUF_LEN
    int "RF buffer length used by RFAL NFC layer"
    default 258

config RFAL_FEATURE_ISO_DEP_APDU_MAX_LEN
    int "ISO-DEP APDU max length. Please use multiples of I-Block max length"
    default 512

config RFAL_FEATURE_NFC_DEP_PDU_MAX_LEN
    int "NFC-DEP PDU max length"
    default 512

choice ST25R_TRIGGER_MODE
	prompt "Trigger mode"
	help
	  Specify the type of triggering to be used by the driver.

config ST25R_TRIGGER_NONE
	bool "No trigger"

config ST25R_TRIGGER_GLOBAL_THREAD
	bool "Use global thread"
	depends on GPIO
	select ST25R_TRIGGER

config ST25R_TRIGGER_OWN_THREAD
	bool "Use own thread"
	depends on GPIO
	select ST25R_TRIGGER

endchoice

config ST25R_THREAD_PRIORITY
	int "Thread priority"
	depends on ST25R_TRIGGER_OWN_THREAD
	default 10
	help
	  Priority of thread used by the driver to handle interrupts.

config ST25R_THREAD_STACK_SIZE
	int "Thread stack size"
	depends on ST25R_TRIGGER_OWN_THREAD
	default 1024
	help
	  Stack size of thread used by the driver to handle interrupts.

endif # ST25R

module = ST25R
module-str = st25r
```

## zephyr/dts/bindings/st,st25r/st,st25r-common.yaml
```yaml
# Copyright © 2023 Vouch.io LLC
#
# SPDX-License-Identifier: Apache-2.0

properties:
  
    irq-gpios:
      type: phandle-array
      required: true
      description: IRQ pin (active high)
```

## zephyr/dts/bindings/st,st25r/st,st25r-i2c.yaml
```yaml
# Copyright © 2023 Vouch.io LLC
#
# SPDX-License-Identifier: Apache-2.0

description: ST25R driver on I2C bus

compatible: "st,st25r"

include: ["i2c-device.yaml", "st,st25r-common.yaml"]
```

## zephyr/dts/bindings/st,st25r/st,st25r-spi.yaml
```yaml
# Copyright © 2023 Vouch.io LLC
#
# SPDX-License-Identifier: Apache-2.0

description: ST25R driver on SPI bus

compatible: "st,st25r"

include: ["spi-device.yaml", "st,st25r-common.yaml"]
```
